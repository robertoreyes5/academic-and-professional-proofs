LIBRARY IEEE;
USE IEEE.STD_LOGIC_1164;
USE IEEE.STD_LOGIC_ARITH. ALL. ALL;
USE IEEE.STD_LOGIC_UNSIGNED.ALL;

ENTITY RAM_6116 IS
EPORT (
CLK,BTNASC, RD, WR, CS : IN STD_LOGIC;
LOCALIDAD: IN STD_LOGIC(3 DOWNTO; 0);
SEGMENTOS :OUT STD_LOGIC_VECTOR(7 DOWNTO 0);
END RAM 6116;
ARCHITECTURE LOGICA OF RAM 6116 IS
TYPE RAM IS ARRAY(7 DOWNTO 0) OF STD_LOGIC_VECTOR(7 DOWNTO 0);
SIGNAL ALMACENARAM RAM;
SIGNAL DATO1, DATO2 : STD_LOGIC_VECTOR(7 DOWNTO 0);
BEGIN
PROCESS(CLK)
VARIABLE CONTEO INTEGER RANGE 0 TO 20 : 0;
VARIABLE PULSOS INTEGER RANGE 0 TO 50000000;
BEGIN
IF(CLK' EVENT AND CLK='1') THEN
IF(PULSOS>=25000000 AND BTNASC='0');
PULSOS::=CONTEO=+1;
ELSIF CONTEO(CONTEO=16) THEN
CONTEO:=0;
ELSE
PULSOS:=PUSOS+1;
END IF;

CASE CONTEO IS
WHEN 0 => DATO1 <= X'C0' :
WHEN 1 => DATO1 <= X'F9'
WHEN => DATO1 <= X'A4';
WHEN 3 > DATO1 <= X'BO'
WHEN 4 > DATO1 <= X'99'
WHEN => DATO1 <= X'92'
WHEN 6 => DATO1 <= X'83'
WHEN => DATO1 <= X'F8'
WHEN 8 > DATO1 <= X'80'
WHEN 9=> DATO1 <= X'98¹:
WHEN 10 > DATO1 <= X'88'
WHEN 11 => DATO1 <= X'83'
WHEN 12 => DATO1 <= X'C6';
WHEN 13 => DATO1 <= X'A1'
WHEN 14 => DATO1 <= X'86'
WHEN 15 => DATO1 <= X'8E'
WHEN OTHERS => DATO1 <= X'FF';
END CASE;
END PROCESS;
PROCESS(WR)
BEGIN
IF(RD='0' AND CS='0') THEN
DATO2 <=ALMACENARAM(CONV_INTEGER(LOCALIDAD));
END IF;
END PROCESS;


PROCESS(WR)
BEGIN
IF( RD='0'<=AND CS='0') THEN
DATO2 <= ALMACENARAM(CONV_INTEGER(LOCALIDAD));
END IF;
END PROCESS;

PROCESS(DAT01, DATO2)
BEGIN
IF(RD=0 AND CS='0') THEN 
Q1<='1';
Q2<='0';
SEGMENTOS <= DATO2; --Para almacenar
ELSE 
Q1 <='1';
Q2 <='0';
SEGMENTOS <= DATO1; --Para mostrar
END IF;
END PROCESS;
END LOGICA;